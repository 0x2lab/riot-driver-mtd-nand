## drivers/mtd_nand/Kconfig
```kconfig
# Copyright (c) 2022 Jongmin Kim <jmkim@pukyong.ac.kr>
#
# This file is subject to the terms and conditions of the GNU Lesser
# General Public License v2.1. See the file LICENSE in the top level
# directory for more details.
#
menuconfig KCONFIG_USEMODULE_MTD_NAND
    bool "Configure MTD_NAND driver"
    depends on USEMODULE_MTD_NAND
    help
        Configure the MTD_NAND driver using Kconfig.

if KCONFIG_USEMODULE_MTD_NAND

endif # KCONFIG_USEMODULE_MTD_NAND
```

## drivers/mtd_nand_onfi/Kconfig
```kconfig
# Copyright (c) 2022 Jongmin Kim <jmkim@pukyong.ac.kr>
#
# This file is subject to the terms and conditions of the GNU Lesser
# General Public License v2.1. See the file LICENSE in the top level
# directory for more details.
#
menuconfig KCONFIG_USEMODULE_MTD_NAND_ONFI
    bool "Configure MTD_NAND_ONFI driver"
    depends on USEMODULE_MTD_NAND_ONFI
    help
        Configure the MTD_NAND_ONFI driver using Kconfig.

if KCONFIG_USEMODULE_MTD_NAND_ONFI

endif # KCONFIG_USEMODULE_MTD_NAND_ONFI
```

## drivers/nand/Kconfig
```kconfig
# Copyright (c) 2022 Jongmin Kim <jmkim@pukyong.ac.kr>
#
# This file is subject to the terms and conditions of the GNU Lesser
# General Public License v2.1. See the file LICENSE in the top level
# directory for more details.
#

config MODULE_NAND
    bool "NAND"
    depends on HAS_PERIPH_GPIO
    depends on TEST_KCONFIG
    select MODULE_PERIPH_GPIO
    select MODULE_ZTIMER
    select ZTIMER_USEC

config HAS_NAND
    bool
    help
      Indicates that a NAND is present.
```

## drivers/nand_onfi/Kconfig
```kconfig
# Copyright (c) 2022 Jongmin Kim <jmkim@pukyong.ac.kr>
#
# This file is subject to the terms and conditions of the GNU Lesser
# General Public License v2.1. See the file LICENSE in the top level
# directory for more details.
#

config MODULE_NAND_ONFI
    bool "ONFI NAND"
    depends on HAS_NAND
    depends on TEST_KCONFIG
    select MODULE_NAND

config HAS_NAND_ONFI
    bool
    help
      Indicates that a ONFI NAND is present.
```
